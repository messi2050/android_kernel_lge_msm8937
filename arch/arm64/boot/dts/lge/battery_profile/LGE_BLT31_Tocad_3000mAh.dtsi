qcom,LGE_BLT31_Tocad_3000mAh {
	/* #2738126_LGE_BLT31_3000mAh_averaged_MasterSlave_Jan12th2017*/
	qcom,max-voltage-uv = <4400000>;
	qcom,nom-batt-capacity-mah = <3000>;
	qcom,batt-id-kohm = <0>;
	qcom,battery-beta = <4250>;
	qcom,battery-type = "LGE_BLT31_Tocad_3000mAh";
	qcom,chg-rslow-comp-c1 = <3617798>;
	qcom,chg-rslow-comp-c2 = <5826142>;
	qcom,chg-rs-to-rslow = <1068160>;
	qcom,chg-rslow-comp-thr = <0xB1>;
	qcom,checksum = <0x74D3>;
	qcom,gui-version = "PMI8950GUI - 2.0.0.16";
	qcom,fg-profile-data = [
		 DD 83 9F 7C
		 D0 80 A2 76
		 55 83 C5 5D
		 D3 82 46 8E
		 53 82 74 98
		 6C B6 35 C2
		 56 17 06 88
		 B3 7D 68 81
		 78 77 47 83
		 F3 72 A5 7C
		 D9 69 57 82
		 5C 99 87 BC
		 26 C9 5F 0C
		 C0 0B E5 5B
		 14 70 29 FC
		 26 2B 30 46
		 77 39 00 00
		 EE 46 6D 07
		 C6 3A 00 00
		 00 00 00 00
		 00 00 00 00
		 AF 70 28 6B
		 D7 7D 6E 88
		 52 7C 4C 70
		 FD 74 84 79
		 9A 76 23 69
		 1A 77 93 B0
		 21 36 63 EB
		 64 A0 71 0C
		 28 00 FF 36
		 F0 11 30 03
		 00 00 00 0C
	];
};
