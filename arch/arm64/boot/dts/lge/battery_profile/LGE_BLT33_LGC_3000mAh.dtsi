qcom,LGE_BLT33_LGC_3000mAh {
	/* #2849845_LGE_BLT33_3000mAh_averaged_MasterSlave_Mar28th2017*/
	qcom,max-voltage-uv = <4400000>;
	qcom,nom-batt-capacity-mah = <3000>;
	qcom,batt-id-kohm = <4573>;
	qcom,batt-scale-criteria = <0xF0>;
	qcom,batt-recharge-threshold = <0xF5>;
	qcom,battery-beta = <4150>;
	qcom,battery-type = "LGE_BLT33_LGC_3000mAh";
	qcom,chg-rslow-comp-c1 = <4160430>;
	qcom,chg-rslow-comp-c2 = <8029388>;
	qcom,chg-rs-to-rslow = <1552170>;
	qcom,chg-rslow-comp-thr = <0xBD>;
	qcom,checksum = <0xED59>;
	qcom,gui-version = "PMI8950GUI - 2.0.0.16";
	qcom,fg-profile-data = [
		 D0 83 F8 77
		 1F 80 CD 74
		 5C 83 28 6D
		 71 88 BB 8F
		 30 82 04 99
		 35 B7 FE C2
		 55 12 FA 83
		 20 7D E0 80
		 1E 76 49 83
		 05 72 A2 74
		 7E 75 6A 82
		 79 98 9E B6
		 55 C2 5B 0D
		 05 0C E1 58
		 14 70 71 FD
		 B2 3F 2A 3C
		 E6 39 00 00
		 53 4C 2C 40
		 5F 28 00 00
		 00 00 00 00
		 00 00 00 00
		 3B 71 98 70
		 E1 61 B1 79
		 9C 6F 6D 4B
		 98 68 65 7A
		 24 6F 69 4B
		 08 5E C7 AB
		 1B 33 6A 2A
		 6C A0 71 0C
		 28 00 FF 36
		 F0 11 30 03
		 00 00 00 0C
	];
};
